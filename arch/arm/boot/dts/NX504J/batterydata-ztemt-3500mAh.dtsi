/* Copyright (c) 2013, The Linux Foundation. All rights reserved.
 *
 * This program is free software; you can redistribute it and/or modify
 * it under the terms of the GNU General Public License version 2 and
 * only version 2 as published by the Free Software Foundation.
 *
 * This program is distributed in the hope that it will be useful,
 * but WITHOUT ANY WARRANTY; without even the implied warranty of
 * MERCHANTABILITY or FITNESS FOR A PARTICULAR PURPOSE.  See the
 * GNU General Public License for more details.
 */
/*
CONFIG_ZTEMT_NX504J_CHARGE
*/
qcom,ztemt-3500mah {
	/* Data Can not be delete*/
  qcom,fcc-mah = <3500>;
	qcom,default-rbatt-mohm = <124>;
	qcom,max-voltage-uv = <4350000>; 
	qcom,rbatt-capacitive-mohm = <50>;
	qcom,v-cutoff-uv = <3400000>;
	qcom,chg-term-ua = <100000>;
	qcom,batt-id-kohm = <300>;

	qcom,fcc-temp-lut {
		qcom,lut-col-legend = <(-20) (-5) 0 25 40 45 50 60>;
		qcom,lut-data = <3483  3460  3503  3505  3495> ;
	};

	qcom,pc-temp-ocv-lut {
		qcom,lut-col-legend = <(-20) (-5) 0 25 40 45 50 60>;
		qcom,lut-row-legend = <100 95 90 85 80>,
				<75 70 65 60 55>,
				<50 45 40 35 30>,
				<25 20 16 13 11>,
				<10 9 8 7 6>,
				<5 4 3 2 1>,
				<0>;
		qcom,lut-data =<4318  4316  4315  4311  4304>, 
						<4209  4231  4249  4247  4243>, 
						<4130  4177  4195  4193  4189>, 
						<4080  4123  4143  4141  4137>, 
						<4009  4072  4092  4090  4087>, 
						<3928  4014  4055  4048  4040>, 
						<3892  3945  3988  3997  3997>, 
						<3852  3915  3960  3961  3958>, 
						<3820  3886  3914  3921  3920>, 
						<3801  3856  3866  3867  3867>, 
						<3786  3829  3839  3839  3838>, 
						<3772  3806  3817  3817  3816>, 
						<3758  3785  3798  3799  3798>, 
						<3742  3767  3783  3784  3782>, 
						<3726  3752  3771  3767  3761>, 
						<3706  3736  3757  3751  3738>, 
						<3683  3722  3739  3730  3716>, 
						<3660  3713  3712  3704  3689>, 
						<3638  3705  3691  3682  3671>, 
						<3622  3698  3688  3680  3668>, 
						<3613  3693  3687  3679  3668>, 
						<3602  3688  3686  3679  3666>, 
						<3589  3682  3685  3677  3665>, 
						<3574  3672  3683  3675  3662>, 
						<3556  3657  3677  3668  3650>, 
						<3533  3633  3655  3643  3617>, 
						<3502  3595  3609  3594  3564>, 
						<3459  3536  3543  3528  3494>, 
						<3390  3443  3449  3433  3395>, 
						<3265  3296  3301  3282  3237>, 
						<3000  3000  3000  3000  3000>;
	};

	qcom,rbatt-sf-lut {
		qcom,lut-col-legend = <(-20) (-5) 0 25 40 45 50 60>;
		qcom,lut-row-legend =<100 95 90 85 80>,
				<75 70 65 60 55>,
				<50 45 40 35 30>,
				<25 20 16 13 11>,
				<10 9 8 7 6>,
				<5 4 3 2 1>,
				<0>;
		qcom,lut-data = <1457  315  100  83  79>, 
								<1385  317  101  84  79>, 
								<1386  317  102  85  80>, 
								<1349  312  105  87  81>, 
								<1266  298  108  88  82>, 
								<1161  300  116  93  83>, 
								<1162  272  120  95  85>, 
								<1144  274  132  99  88>, 
								<1145  271  128  111  95>, 
								<1184  268  101  86  81>, 
								<1231  268  100  85  81>, 
								<1291  269  100  87  82>, 
								<1357  268  102  88  84>, 
								<1427  267  104  91  86>, 
								<1502  268  105  89  83>, 
								<1580  269  104  87  82>, 
								<1674  281  103  85  81>, 
								<1746  308  102  85  82>, 
								<1825  340  97  83  80>, 
								<1887  362  99  85  82>, 
								<1793  364  100  86  83>, 
								<1749  348  102  88  84>, 
								<1881  347  106  90  87>, 
								<2037  355  111  92  91>, 
								<2227  364  115  95  89>, 
								<2468  369  111  89  83>, 
								<2801  377  105  87  83>, 
								<3304  395  107  90  86>, 
								<4477  432  116  96  99>, 
								<16644  7270  656  229  664>, 
								<98633  40870  22995  35025  29700>;
	};
};
