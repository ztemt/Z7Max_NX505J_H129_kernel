## arch/arm/mach-msm/board/Kconfig
```kconfig
#
# Board configuration
#
menuconfig ARCH_MSM8974
	bool "Select the Supported Board of Nubia"
	help
	  Say Y here, and a list of supported Boards will be displayed.
	  This option doesn't affect the kernel.

	  If unsure, say Y.

if ARCH_MSM8974

config ARCH_MSM8974_ORIG
	bool "Original ARCH_MSM8974"
	help
	  Support for Qualcomm MSM8974AB/AC MTP original eval board.
	  
config ARCH_MSM8974_ZTEMT
	bool "ZTEMT ARCH_MSM8974"
	help
	  Support for ZTEMT MSM8974AB/AC MTP board.

choice
	depends on ARCH_MSM8974_ZTEMT
	prompt "MSM8974_MTP Based ZTEMT Board"
	
config BOARD_ZTEMT_NX601J
	bool "ZTEMT NX601J"
	help
	  Support for the ZTEMT NX601J board.

config BOARD_ZTEMT_NX504J
	bool "ZTEMT NX504J"
	help
	  Support for the ZTEMT NX504J board.

config BOARD_ZTEMT_NX505J
	bool "ZTEMT NX505J"
	help
	  Support for the ZTEMT NX505J board.

config BOARD_ZTEMT_NX506J
	bool "ZTEMT NX506J"
	help
	  Support for the ZTEMT NX506J board.

config BOARD_ZTEMT_NX507J
	bool "ZTEMT NX507J"
	help
	  Support for the ZTEMT NX507J board.	

config BOARD_ZTEMT_NX503A
	bool "ZTEMT NX503A"
	help
	  Support for the ZTEMT NX503A board.	
endchoice	

config ZTEMT_RESTART
	bool "ZTEMT restart"
	help
	  Support for the ZTEMT restart

config EMMC_UNSUPPORTED_HPI
	bool "ZTEMT emmc unsupported hpi feature"
	help
	  emmc unsupported hpi feature.
endif
```

## drivers/video/msm/mdss/slimport_anx7808/Kconfig
```kconfig
config SLIMPORT_ANX7808
	tristate "Analogix Slimport transmitter ANX7808 support"
	help
	  Slimport Transmitter is a HD video transmitter chip
	  over micro-USB connector for smartphone device.

config SLIMPORT_FAST_CHARGE
	bool "enable fast charge from Slimport accessary"
	depends on 	SLIMPORT_ANX7808
	default y
	help
		The maximum charge current can be up to 1A via Slimport accessay,
		 if this feature is enabled.
		 
config SLIMPORT_CEC
	bool "enable CEC from Slimport accessary"
	depends on 	SLIMPORT_ANX7808
	default y
	help
		CEC.
		 
source "drivers/video/msm/mdss/slimport_anx7808/cec_lib/Kconfig"
```

## drivers/video/msm/mdss/slimport_anx7808/cec_lib/Kconfig.bak
```kconfig
config SLIMPORT_CEC
	bool "enable CEC feature via Slimport"
	depends on 	SLIMPORT_ANX7808
	help
		The maximum charge current can be up to 1A via Slimport accessay,
		 if this feature is enabled.
```

## fs/exfat/Kconfig
```kconfig
config EXFAT_FS
	tristate "EXFAT fs support"
	help
	  This option provides support for EXFAT file system.

config EXFAT_DEFAULT_CODEPAGE
	int "Default codepage for EXFAT"
	depends on EXFAT_FS
	default 437
	help
	  This option should be set to the codepage of your EXFAT filesystems.
	  It can be overridden with the "codepage" mount option.

config EXFAT_DEFAULT_IOCHARSET
	string "Default iocharset for EXFAT"
	depends on EXFAT_FS
	default "utf8"
	help
	  Set this to the default input/output character set you'd
	  like EXFAT to use. It should probably match the character set
	  that most of your EXFAT filesystems use, and can be overridden
	  with the "iocharset" mount option for EXFAT filesystems.

	  Enable any character sets you need in File Systems/Native Language
	  Support.
```
